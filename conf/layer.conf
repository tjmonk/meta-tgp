## conf/layer.conf
```bitbake
# We have a conf and classes directory, add to BBPATH
BBPATH .= ":${LAYERDIR}"

# We have recipes-* directories, add to BBFILES
BBFILES += "${LAYERDIR}/recipes-*/*/*.bb \
            ${LAYERDIR}/recipes-*/*/*.bbappend"

BBFILE_COLLECTIONS += "tgp"
BBFILE_PATTERN_tgp = "^${LAYERDIR}/"
BBFILE_PRIORITY_tgp = "6"

LAYERDEPENDS_tgp = "core"
LAYERSERIES_COMPAT_tgp = "thud kirkstone mickledore scarthgap"
```

## meta-tgp-core/conf/layer.conf
```bitbake
# We have a conf and classes directory, add to BBPATH
BBPATH .= ":${LAYERDIR}"

# We have recipes-* directories, add to BBFILES
BBFILES += "${LAYERDIR}/recipes-*/*/*.bb \
            ${LAYERDIR}/recipes-*/*/*.bbappend"

BBFILE_COLLECTIONS += "tgp-core"
BBFILE_PATTERN_tgp-core = "^${LAYERDIR}/"
BBFILE_PRIORITY_tgp-core = "6"

LAYERDEPENDS_tgp-core = "core"
LAYERSERIES_COMPAT_tgp-core = "kirkstone mickledore"
```

## meta-tgp-extras/conf/layer.conf
```bitbake
# We have a conf and classes directory, add to BBPATH
BBPATH .= ":${LAYERDIR}"

# We have recipes-* directories, add to BBFILES
BBFILES += "${LAYERDIR}/recipes-*/*/*.bb \
            ${LAYERDIR}/recipes-*/*/*.bbappend"

BBFILE_COLLECTIONS += "tgp-extras"
BBFILE_PATTERN_tgp-extras = "^${LAYERDIR}/"
BBFILE_PRIORITY_tgp-extras = "6"

LAYERDEPENDS_tgp-extras = "core"
LAYERSERIES_COMPAT_tgp-extras = "kirkstone mickledore"
```
